# MSP430FR2476 register map
Vendor: msp430gen; File version: v0.4.0
Registers are 16-bit, read-write, reset 0x0 unless marked. A register's access mark holds for its fields unless they carry their own. Offsets are from the block's base; lines under a group give offsets from that group; [hi:lo] are bit positions; {n}, {i} and the like mark numbered series; 'fields as' and 'values as' point back to an identical list; <NAME> marks a mode.

## Memory map
0x00000100 SFR
0x00000120 PMM
0x00000140 SYS
0x00000180 CS
0x000001A0 FRCTL
0x000001C0 CRC
0x000001CC WDT_A
0x00000200 P1
0x00000200 P2
0x00000220 P3
0x00000220 P4
0x00000240 P5
0x00000240 P6
0x00000300 RTC
0x00000320 PJ
0x00000380 TA0
0x000003C0 TA1
0x00000400 TA2
0x00000440 TA3
0x00000480 TB0
0x000004C0 MPY32
0x00000500 E_USCI_A0
0x00000520 E_USCI_A1
0x00000540 E_USCI_B0
0x00000580 E_USCI_B1
0x00000660 BKMEM
0x00000700 ADC
0x000008E0 E_COMP0
0x0000FF80 _INTERRUPTS

## Interrupts
19 ECOMP0 (_INTERRUPTS) — 0xFFCA
20 PORT6 (_INTERRUPTS) — 0xFFCC
21 PORT5 (_INTERRUPTS) — 0xFFCE
22 PORT4 (_INTERRUPTS) — 0xFFD0
23 PORT3 (_INTERRUPTS) — 0xFFD2
24 PORT2 (_INTERRUPTS) — 0xFFD4
25 PORT1 (_INTERRUPTS) — 0xFFD6
26 ADC (_INTERRUPTS) — 0xFFD8
27 EUSCI_B1 (_INTERRUPTS) — 0xFFDA
28 EUSCI_B0 (_INTERRUPTS) — 0xFFDC
29 EUSCI_A1 (_INTERRUPTS) — 0xFFDE
30 EUSCI_A0 (_INTERRUPTS) — 0xFFE0
31 WDT (_INTERRUPTS) — 0xFFE2
32 RTC (_INTERRUPTS) — 0xFFE4
33 TIMER0_B1 (_INTERRUPTS) — 0xFFE6
34 TIMER0_B0 (_INTERRUPTS) — 0xFFE8
35 TIMER3_A1 (_INTERRUPTS) — 0xFFEA
36 TIMER3_A0 (_INTERRUPTS) — 0xFFEC
37 TIMER2_A1 (_INTERRUPTS) — 0xFFEE
38 TIMER2_A0 (_INTERRUPTS) — 0xFFF0
39 TIMER1_A1 (_INTERRUPTS) — 0xFFF2
40 TIMER1_A0 (_INTERRUPTS) — 0xFFF4
41 TIMER0_A1 (_INTERRUPTS) — 0xFFF6
42 TIMER0_A0 (_INTERRUPTS) — 0xFFF8
43 UNMI (_INTERRUPTS) — 0xFFFA
44 SYSNMI (_INTERRUPTS) — 0xFFFC

## P1
Base 0x00000200
0x00 P1IN 8-bit — Port 1 Input
0x02 P1OUT 8-bit — Port 1 Output
0x04 P1DIR 8-bit — Port 1 Direction
0x06 P1REN 8-bit — Port 1 Resistor Enable
0x0A P1SEL0 8-bit — Port 1 Select 0
0x0C P1SEL1 8-bit — Port 1 Select 1
0x0E P1IV — Port 1 Interrupt Vector Register
  [4:0] P1IV ro — Port 1 interrupt vector value
    0=NONE (No interrupt pending); 2=P1IFG0 (Interrupt Source: Port 1.0 interrupt; Interrupt Flag: P1IFG0; Interrupt Priority: Highest); 4=P1IFG1 (Interrupt Source: Port 1.1 interrupt; Interrupt Flag: P1IFG1); 6=P1IFG2 (Interrupt Source: Port 1.2 interrupt; Interrupt Flag: P1IFG2); 8=P1IFG3 (Interrupt Source: Port 1.3 interrupt; Interrupt Flag: P1IFG3); 10=P1IFG4 (Interrupt Source: Port 1.4 interrupt; Interrupt Flag: P1IFG4); 12=P1IFG5 (Interrupt Source: Port 1.5 interrupt; Interrupt Flag: P1IFG5); 14=P1IFG6 (Interrupt Source: Port 1.6 interrupt; Interrupt Flag: P1IFG6); 16=P1IFG7 (Interrupt Source: Port 1.7 interrupt; Interrupt Flag: P1IFG7; Interrupt Priority: Lowest)
0x16 P1SELC 8-bit — Port 1 Complement Select
0x18 P1IES 8-bit — Port 1 Interrupt Edge Select
0x1A P1IE 8-bit — Port 1 Interrupt Enable
0x1C P1IFG 8-bit — Port 1 Interrupt Flag

## P2
Base 0x00000200
0x01 P2IN 8-bit — Port 2 Input
0x03 P2OUT 8-bit — Port 2 Output
0x05 P2DIR 8-bit — Port 2 Direction
0x07 P2REN 8-bit — Port 2 Resistor Enable
0x0B P2SEL0 8-bit — Port 2 Select 0
0x0D P2SEL1 8-bit — Port 2 Select 1
0x17 P2SELC 8-bit — Port 2 Complement Select
0x19 P2IES 8-bit — Port 2 Interrupt Edge Select
0x1B P2IE 8-bit — Port 2 Interrupt Enable
0x1D P2IFG 8-bit — Port 2 Interrupt Flag
0x1E P2IV — Port 2 Interrupt Vector Register
  [4:0] P2IV ro — Port 2 interrupt vector value
    0=NONE (No interrupt pending); 2=P2IFG0 (Interrupt Source: Port 2.0 interrupt; Interrupt Flag: P2IFG0; Interrupt Priority: Highest); 4=P2IFG1 (Interrupt Source: Port 2.1 interrupt; Interrupt Flag: P2IFG1); 6=P2IFG2 (Interrupt Source: Port 2.2 interrupt; Interrupt Flag: P2IFG2); 8=P2IFG3 (Interrupt Source: Port 2.3 interrupt; Interrupt Flag: P2IFG3); 10=P2IFG4 (Interrupt Source: Port 2.4 interrupt; Interrupt Flag: P2IFG4); 12=P2IFG5 (Interrupt Source: Port 2.5 interrupt; Interrupt Flag: P2IFG5); 14=P2IFG6 (Interrupt Source: Port 2.6 interrupt; Interrupt Flag: P2IFG6); 16=P2IFG7 (Interrupt Source: Port 2.7 interrupt; Interrupt Flag: P2IFG7; Interrupt Priority: Lowest)
